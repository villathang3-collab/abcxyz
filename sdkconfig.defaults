## sdkconfig.defaults
```kconfig
# Cấu hình Flash OPI
CONFIG_ESPTOOLPY_FLASHMODE_OPI=y
CONFIG_ESPTOOLPY_FLASH_SAMPLE_MODE_STR=y
CONFIG_ESPTOOLPY_FLASHMODE="opi"
CONFIG_ESPTOOLPY_FLASHFREQ_80M=y
CONFIG_ESPTOOLPY_FLASHSIZE_16MB=y

# Cấu hình PSRAM OPI
CONFIG_SPIRAM=y
CONFIG_SPIRAM_MODE_OCT=y
CONFIG_SPIRAM_SPEED_80M=y
CONFIG_SPIRAM_TYPE_AUTO=y

# Các cấu hình phụ trợ cho C5
CONFIG_ESP32C5_UNIVERSAL_MAC_ADDRESSES_FOUR=y
```
